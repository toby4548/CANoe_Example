VERSION "DNNBNNNYNNNNNNNNNNNNNNNNNNYYYNNNNNNNNNNNNN/4/%%%/4/'%**4NNN///"

NS_ :

BS_:

BU_: LightControl MotorControl Dashboard LightSwitch

BO_ 291 MsgMotorState: 3 MotorControl
 SG_ SigEngineSpeed : 0|16@1+ (1,0) [0|4000] "rpm"  Dashboard
 SG_ SigEngineOnOff : 16|1@1+ (1,0) [0|1] ""  LightControl,Dashboard

BO_ 801 MsgLightState: 1 LightSwitch
 SG_ SigAlarmSignal : 1|1@1+ (1,0) [0|1] ""  LightControl
 SG_ SigLightOnOff : 0|1@1+ (1,0) [0|1] ""  LightControl

EV_ EnvParkLight: 0 [0|0] "" 0 1 DUMMY_NODE_VECTOR0  LightControl;

EV_ EnvTurnSignal: 0 [0|0] "" 0 2 DUMMY_NODE_VECTOR0 Vector__XXX;

EV_ EnvLightDsp: 0 [0|0] "" 0 3 DUMMY_NODE_VECTOR0 Vector__XXX;

EV_ EnvTurnSignalLight: 0 [0|2] "" 0 4 DUMMY_NODE_VECTOR0 Vector__XXX;

EV_ EnvEngineSpeedMonitor: 0 [0|3500] "" 0 5 DUMMY_NODE_VECTOR2  Dashboard;

EV_ EnvSpeedEntry: 1 [0|3500] "" 0 6 DUMMY_NODE_VECTOR1  MotorControl;

EV_ EnvMotorSwitch: 0 [0|1] "" 0 7 DUMMY_NODE_VECTOR1  MotorControl;

EV_ EnvMotor: 0 [0|1] "" 0 8 DUMMY_NODE_VECTOR2  Dashboard;

EV_ EnvLightSwitch: 0 [0|2] "" 0 9 DUMMY_NODE_VECTOR1  LightSwitch;

BA_DEF_ BU_  "ILUsed" ENUM  "Yes","No";
BA_DEF_ SG_  "GenSigSendType" ENUM  "Cyclic","OnWrite","OnWriteWithRepetition","OnChange","OnChangeWithRepetition","IfActive","IfActiveWithRepetition";
BA_DEF_ BO_  "GenMsgDelayTime" INT 1 1000;
BA_DEF_ BO_  "GenMsgCycleTime" INT 2 50000;
BA_DEF_ BO_  "GenMsgCycleTimeFast" INT 2 100000;
BA_DEF_ BO_  "GenMsgILSupport" ENUM  "No","Yes";
BA_DEF_ BU_  "NodeLayerModules" STRING ;
BA_DEF_DEF_  "ILUsed" "Yes";
BA_DEF_DEF_  "GenSigSendType" "Cyclic";
BA_DEF_DEF_  "GenMsgDelayTime" 1;
BA_DEF_DEF_  "GenMsgCycleTime" 2;
BA_DEF_DEF_  "GenMsgCycleTimeFast" 100;
BA_DEF_DEF_  "GenMsgILSupport" "Yes";
BA_DEF_DEF_  "NodeLayerModules" "CANoeILNLVector.dll";
BA_ "GenMsgCycleTimeFast" BO_ 291 10;
BA_ "GenMsgCycleTime" BO_ 291 10;
BA_ "GenMsgCycleTime" BO_ 801 100;
BA_ "GenSigSendType" SG_ 801 SigLightOnOff 3;
