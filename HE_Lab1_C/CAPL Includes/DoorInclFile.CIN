/*@@var:*/
variables
{
  // additionally Variables for Node-Simulation
  msTimer tMoveUpTimer;
  msTimer tMoveDownTimer;

  int gPosWN;
  const int cMoveTime = 100; //ms

  int gMoveDown = 0;
  int gMoveUp	= 0;
  int gMoveSpeedDown = 0;

  const int gTrue  = 1;
  const int gFalse = 0;

  msTimer tWakeUpDsp; 
  long gWakeUpDspTime = 1500;

}
/*@@end*/

/*@@caplFunc:WakeUpDsp():*///function
WakeUpDsp ()
{
  cancelTimer(tWakeUpDsp);
  setTimer(tWakeUpDsp,gWakeUpDspTime); 
}
/*@@end*/

/*@@caplFunc:SetMoveTimer():*///function
SetMoveTimer ()
{
  setTimer(tMoveDownTimer,cMoveTime);
  setTimer(tMoveUpTimer  ,cMoveTime);
  setTimer(tMoveSpeedDownTimer,cMoveTime);
}
/*@@end*/

