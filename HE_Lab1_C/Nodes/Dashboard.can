/*@!Encoding:1252*/
variables 
{
    int VarKeyIndication = 0;
}

on message MsgMotorState 
{  
   //If the motor is stopped, the buttons below will be reset 
   if(!this.SigEngineActive)
   {
        putValue(EnvWiperButton,        0);
        PutValue(EnvBlinkLeftButton,    0);
        PutValue(EnvBlinkRightButton,   0);
        PutValue(EnvAcceleratorPedal,getSignal(MsgMotorState::SigEngineSpeed));        
        SetSignal(MsgMotorCmd::SigAcceleratorPosition,0 );
        VarKeyIndication = 0;
   }
  // When turning on the car key, the accelerator position will be set to 750 rpm
   else if(this.SigEngineActive && !VarKeyIndication)
   {
        PutValue(EnvAcceleratorPedal,getSignal(MsgMotorState::SigEngineSpeed));        
        SetSignal(MsgMotorCmd::SigAcceleratorPosition,750 );
        VarKeyIndication = 1;
   }     
   else if(this.SigEngineActive && VarKeyIndication==1 && getSignal(MsgBrakeState::SigBrakeActive))
   {
        PutValue(EnvAcceleratorPedal,getSignal(MsgMotorState::SigEngineSpeed));        
   }
}

on start
{
}

// Set the blink left signal, if the blink left button is clicked
on envVar EnvBlinkLeftButton
{  
    if(getValue(this))
    {   // Reset the blink right button, if the blink left button is pressed
        putValue(EnvBlinkRightButton, 0);  
    }
    // Set the blink left signal
    SetSignal(MsgBlinkCmd::SigBlinkLeftCmd, getValue(this));
}

// Set the blink right signal, if the blink right button is clicked
on envVar EnvBlinkRightButton
{
    if(getValue(this))
    {   // Reset the blink left button, if the blink right button is pressed
        putValue(EnvBlinkLeftButton, 0);
    }
    // Set the blink right signal
    SetSignal(MsgBlinkCmd::SigBlinkRightCmd, getValue(this));
}

// Send the alarm signal, if the alarm button is clicked
on envVar EnvAlarmButton
{   if (getValue(this))
    {   PutValue(EnvBlinkLeftButton, 0);    //Reset turn light/blinker buttons
        PutValue(EnvBlinkRightButton,0);
    }
    SetSignal(MsgAlarmCmd::SigAlarmOnOff, getValue(this));
}

// Set the light signal, if the light button is clicked
on envVar EnvLightButton
{
   SetSignal(MsgLightCmd::SigLightOnOff, getValue(this));
}

// Set the engine on/off signal when the ignition switch is clicked
on envVar EnvIgnitionSwitch
{
    SetSignal(MsgMotorCmd::SigEngineOnOff, getValue(this));
}

//Engine speed will be set here if the speed bar is touched (but only, if the ignition switch is on)
on envVar EnvAcceleratorPedal
{
    if(getValue(EnvIgnitionSwitch))
        SetSignal(MsgMotorCmd::SigAcceleratorPosition, getValue(this));
}

on envVar EnvBrakeSwitch
{
    SetSignal(MsgBrakeCmd::SigBrakeOnOff, getValue(this) && getValue(EnvIgnitionSwitch));
}

on message MsgLightState
{   putValue(EnvLightLED, this.SigLightActive);

    putValue(EnvBlinkLeftLED,  this.SigBlinkLeftActive);
    putValue(EnvBlinkRightLED, this.SigBlinkRightActive);
}

on envVar EnvWiperButton
{   //To Do: Send CAN message to body control ECU
    SetSignal(MsgWiperCmd::SigWiperOnOff,getValue(this));
}

on envVar EnvWindowLeftUp
{   //To Do: Send CAN message to body control ECU
    SetSignal(MsgWindowLeft::SigWindowLeftUp,getValue(this));
}

on envVar EnvWindowLeftDown
{   //To Do: Send CAN message to body control ECU
    SetSignal(MsgWindowLeft::SigWindowLeftDown,getValue(this));  
}

